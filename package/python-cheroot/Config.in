## package/python-cheroot/Config.in
```kconfig
config BR2_PACKAGE_PYTHON_CHEROOT
	bool "python-cheroot"
	select BR2_PACKAGE_PYTHON_SIX # runtime
    select BR2_PACKAGE_PYTHON_BACKPORTS_FUNCTOOLS_LRU_CACHE #runtime
	help
	  Cheroot is the high-performance, pure-Python
	  HTTP server used by CherryPy.

	  https://github.com/cherrypy/cheroot
```

## package/python-zc-lockfile/Config.in
```kconfig
config BR2_PACKAGE_PYTHON_ZC_LOCKFILE
   bool "python-zc-lockfile"
   help
     Basic inter-process locks

     http://www.python.org/pypi/zc.lockfile
```
